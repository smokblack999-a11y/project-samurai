/dts-v1/;

/ {
    iommu0: iommu@10000000 {
        compatible = "riscv,iommu";
        reg = <0x0 0x10000000 0x0 0x1000>;
        interrupts = <0x20>;
    };

    pcie0: pcie@20000000 {
        compatible = "pci-host-ecam-generic";
        iommus = <&iommu0 0x2a>;
    };
};
